/**
 * @file    oled.c
 * @brief   SSD1306 OLED I2C 驱动实现
 */

#include "oled.h"
#include <stdio.h>
#include <string.h>

/* ==================== 6×8 ASCII 字库 (ASCII 32~126) ==================== */
static const uint8_t Font6x8[][6] = {
    {0x00,0x00,0x00,0x00,0x00,0x00}, /* ' ' 空格 */
    {0x00,0x00,0x5F,0x00,0x00,0x00}, /* ! */
    {0x00,0x07,0x00,0x07,0x00,0x00}, /* " */
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    {0x44,0x64,0x54,0x4C,0x44,0x00}, /* z */
};

/* ==================== I2C 写命令/数据 ==================== */

static void OLED_WriteCmd(uint8_t cmd)
{
    uint8_t buf[2] = {0x00, cmd};  /* Co=0, D/C#=0 → 命令 */
    HAL_I2C_Master_Transmit(OLED_I2C_HANDLE, OLED_I2C_ADDR, buf, 2, 100);
}

static void OLED_WriteData(uint8_t data)
{
    uint8_t buf[2] = {0x40, data}; /* Co=0, D/C#=1 → 数据 */
    HAL_I2C_Master_Transmit(OLED_I2C_HANDLE, OLED_I2C_ADDR, buf, 2, 100);
}

/* ==================== 初始化 ==================== */

void OLED_Init(void)
{
    HAL_Delay(100);  /* 等待 SSD1306 上电 */

    OLED_WriteCmd(0xAE); /* Display OFF */
    OLED_WriteCmd(0xD5); OLED_WriteCmd(0x80); /* 设置 OSC 频率 */
    OLED_WriteCmd(0xA8); OLED_WriteCmd(0x3F); /* MUX ratio = 64 */
    OLED_WriteCmd(0xD3); OLED_WriteCmd(0x00); /* 显示偏移 = 0 */
    OLED_WriteCmd(0x40); /* 起始行 = 0 */
    OLED_WriteCmd(0x8D); OLED_WriteCmd(0x14); /* 充电泵开启 */
    OLED_WriteCmd(0x20); OLED_WriteCmd(0x00); /* 水平寻址 */
    OLED_WriteCmd(0xA1); /* 段重映射: column 127 = SEG0 */
    OLED_WriteCmd(0xC8); /* COM 扫描方向: 从下到上 */
    OLED_WriteCmd(0xDA); OLED_WriteCmd(0x12); /* COM 引脚配置 */
    OLED_WriteCmd(0x81); OLED_WriteCmd(0xCF); /* 对比度 */
    OLED_WriteCmd(0xD9); OLED_WriteCmd(0xF1); /* 预充电周期 */
    OLED_WriteCmd(0xDB); OLED_WriteCmd(0x40); /* VCOMH 取消选择 */
    OLED_WriteCmd(0xA4); /* 从 RAM 输出, 不强制全亮 */
    OLED_WriteCmd(0xA6); /* 正常显示 (不反色) */
    OLED_WriteCmd(0x2E); /* 不滚动 */

    OLED_WriteCmd(0xAF); /* Display ON */
    OLED_Clear();
}

/* ==================== 基础操作 ==================== */

void OLED_Clear(void)
{
    for (uint8_t page = 0; page < OLED_PAGES; page++) {
        OLED_SetCursor(page, 0);
        for (uint8_t col = 0; col < OLED_WIDTH; col++) {
            OLED_WriteData(0x00);
        }
    }
}

void OLED_Fill(uint8_t pattern)
{
    for (uint8_t page = 0; page < OLED_PAGES; page++) {
        OLED_SetCursor(page, 0);
        for (uint8_t col = 0; col < OLED_WIDTH; col++) {
            OLED_WriteData(pattern);
        }
    }
}

void OLED_SetCursor(uint8_t page, uint8_t col)
{
    OLED_WriteCmd(0xB0 + (page & 0x07));         /* 设置页地址 */
    OLED_WriteCmd(0x00 + (col & 0x0F));          /* 列低 4 位 */
    OLED_WriteCmd(0x10 + ((col >> 4) & 0x0F));   /* 列高 4 位 */
}

/* ==================== 字符/字符串显示 ==================== */

void OLED_ShowChar(uint8_t x, uint8_t y, char ch)
{
    if (ch < ' ' || ch > 'z') ch = ' ';  /* 非法字符显示空格 */

    OLED_SetCursor(y, x);
    for (uint8_t i = 0; i < 6; i++) {
        OLED_WriteData(Font6x8[ch - ' '][i]);
    }
}

void OLED_ShowString(uint8_t x, uint8_t y, const char *str)
{
    while (*str) {
        OLED_ShowChar(x, y, *str);
        x += 6;
        if (x > OLED_WIDTH - 6) {
            x = 0;
            y++;
            if (y >= OLED_PAGES) break;
        }
        str++;
    }
}

void OLED_ShowNum(uint8_t x, uint8_t y, int32_t num, uint8_t len)
{
    char buf[12];
    snprintf(buf, sizeof(buf), "%*ld", len, (long)num);
    OLED_ShowString(x, y, buf);
}

void OLED_ShowFloat(uint8_t x, uint8_t y, float num,
                    uint8_t int_len, uint8_t dec_len)
{
    char buf[16];
    snprintf(buf, sizeof(buf), "%*.*f", int_len + dec_len + 1, dec_len, num);
    OLED_ShowString(x, y, buf);
}

void OLED_Printf(uint8_t x, uint8_t y, const char *fmt, ...)
{
    char buf[32];
    va_list args;
    va_start(args, fmt);
    vsnprintf(buf, sizeof(buf), fmt, args);
    va_end(args);
    OLED_ShowString(x, y, buf);
}

void OLED_ShowHighlight(uint8_t y)
{
    OLED_SetCursor(y, 0);
    for (uint8_t col = 0; col < OLED_WIDTH; col++) {
        OLED_WriteData(0xFF);  /* 反色: 全行白底黑字 */
    }
}
